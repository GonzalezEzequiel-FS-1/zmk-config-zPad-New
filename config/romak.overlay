/ {
    matrix {
        compatible = "zmk,matrix-transform";
        row-gpios = <&gpio0 6 (GPIO_PULL_UP | GPIO_ACTIVE_LOW)>,
                    <&gpio0 8 (GPIO_PULL_UP | GPIO_ACTIVE_LOW)>,
                    <&gpio0 17 (GPIO_PULL_UP | GPIO_ACTIVE_LOW)>,
                    <&gpio0 20 (GPIO_PULL_UP | GPIO_ACTIVE_LOW)>,
                    <&gpio0 22 (GPIO_PULL_UP | GPIO_ACTIVE_LOW)>;
        col-gpios = <&gpio1 15 GPIO_ACTIVE_LOW>,
                    <&gpio0 31 GPIO_ACTIVE_LOW>,
                    <&gpio0 29 GPIO_ACTIVE_LOW>,
                    <&gpio0 2 GPIO_ACTIVE_LOW>;
        diode-direction = "COL2ROW";
    };

    reset_button: reset_button_0 {
        gpios = <&gpio0 24 GPIO_ACTIVE_LOW>;
        label = "Reset Button";
    };
};

&zmk {
    reset-button = &reset_button;
};